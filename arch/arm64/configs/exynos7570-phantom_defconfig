## arch/arm64/configs/exynos7570-phantom_defconfig
```kconfig
#
#
# Phantom
#

CONFIG_CPU_FREQ_GOV_BLU_ACTIVE=y
# CONFIG_CPU_FREQ_DEFAULT_GOV_BLU_ACTIVE is not set
CONFIG_CPU_FREQ_DEFAULT_GOV_INTELLIDEMAND=y
CONFIG_BOEFFLA_WL_BLOCKER=y
CONFIG_POWERSUSPEND=y
# CONFIG_POWERSUSPEND_DEBUG is not set
CONFIG_DYNAMIC_FSYNC=y
```
